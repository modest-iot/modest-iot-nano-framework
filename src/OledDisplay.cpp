/**
 * @file OledDisplay.cpp
 * @brief Implements frame buffer management, text rendering, and drawing primitives for OLED displays.
 * Composes Ssd1306Driver for native SSD1306 I2C protocol via Wire.
 * @date 2026-11-10
 * @version 1.0
 */

#include "OledDisplay.h"
#include <cstring>
#include <cstdint>

const Command OledDisplay::UPDATE_DISPLAY_COMMAND = Command(UPDATE_DISPLAY_COMMAND_IDENTIFIER);
const Command OledDisplay::CLEAR_DISPLAY_COMMAND = Command(CLEAR_DISPLAY_COMMAND_IDENTIFIER);
const Command OledDisplay::SET_BACKLIGHT_COMMAND = Command(SET_BACKLIGHT_COMMAND_IDENTIFIER);

// 5x7 font bitmap for ASCII characters 0x20-0x7E (95 characters)
// Each character is 5 bytes (7 bits per column, packed into 5 bytes)
static constexpr uint8_t FONT_BITMAP[][5] = {
    {0x00, 0x00, 0x00, 0x00, 0x00}, // 0x20 ' '
    {0x00, 0x00, 0x5F, 0x00, 0x00}, // 0x21 '!'
    {0x00, 0x07, 0x00, 0x07, 0x00}, // 0x22 '"'
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    {0x10, 0x08, 0x08, 0x10, 0x08}, // 0x7E '~'
};

OledDisplay::OledDisplay(const uint8_t i2cAddress, CommandHandler* parentHandler)
    : Actuator(static_cast<int>(i2cAddress), parentHandler),
      driver(i2cAddress, DISPLAY_WIDTH_IN_PIXELS, DISPLAY_HEIGHT_IN_PIXELS) {
    clearFrameBuffer();
    driver.initialize();
}

void OledDisplay::executeCommand(const Command command) {
    if (command == UPDATE_DISPLAY_COMMAND) {
        sendFrameBufferToDisplay();
    }
    else if (command == CLEAR_DISPLAY_COMMAND) {
        clearFrameBuffer();
        sendFrameBufferToDisplay();
    }
    else if (command == SET_BACKLIGHT_COMMAND) {
        driver.setDisplayOn(true);
    }
}

void OledDisplay::setText(const char* text, const uint8_t x, const uint8_t y) {
    if (text == nullptr) return;
    uint8_t currentX = x;
    while (*text != '\0') {
        if (currentX + FONT_WIDTH_IN_PIXELS > DISPLAY_WIDTH_IN_PIXELS) break;
        drawCharacter(*text, currentX, y);
        currentX += FONT_WIDTH_IN_PIXELS + 1; // 1 pixel gap between characters
        text++;
    }
}

#if defined(ARDUINO_ARCH_ESP32)
void OledDisplay::setText(const __FlashStringHelper* text, const uint8_t x, const uint8_t y) {
    if (text == nullptr) return;
    const char* flashText = reinterpret_cast<const char*>(text);
    uint8_t currentX = x;
    while (pgm_read_byte(flashText) != '\0') {
        if (currentX + FONT_WIDTH_IN_PIXELS > DISPLAY_WIDTH_IN_PIXELS) break;
        drawCharacter(pgm_read_byte(flashText), currentX, y);
        currentX += FONT_WIDTH_IN_PIXELS + 1; // 1 pixel gap between characters
        flashText++;
    }
}
#endif

void OledDisplay::clearFrameBuffer() const {
    memset(const_cast<uint8_t*>(frameBuffer), 0, sizeof(frameBuffer));
}

void OledDisplay::drawCharacter(const char character, const uint8_t x, const uint8_t y) {
    if (static_cast<uint8_t>(character) < FONT_FIRST_CHARACTER ||
        static_cast<uint8_t>(character) > FONT_LAST_CHARACTER) {
        return;
    }

    const uint8_t index = static_cast<uint8_t>(character) - FONT_FIRST_CHARACTER;
    const uint8_t* glyph = FONT_BITMAP[index];

    for (uint8_t col = 0; col < FONT_WIDTH_IN_PIXELS; col++) {
        const uint8_t bitmap = glyph[col];
        for (uint8_t row = 0; row < FONT_HEIGHT_IN_PIXELS; row++) {
            const bool pixelSet = (bitmap >> row) & 0x01;
            setPixel(x + col, y + row, pixelSet);
        }
    }
}

void OledDisplay::setPixel(const uint8_t x, const uint8_t y, const bool state) {
    if (x >= DISPLAY_WIDTH_IN_PIXELS || y >= DISPLAY_HEIGHT_IN_PIXELS) return;

    const uint8_t page = y / 8;
    const uint8_t bit = y % 8;
    const uint8_t index = page * FRAME_BUFFER_SIZE_IN_BYTES + x;

    if (state) {
        frameBuffer[index] |= 1 << bit;
    } else {
        frameBuffer[index] &= ~(1 << bit);
    }
}

void OledDisplay::sendFrameBufferToDisplay() const {
    driver.sendFrameBuffer(frameBuffer, DISPLAY_WIDTH_IN_PIXELS);
}

void OledDisplay::drawHorizontalLine(const uint8_t x, const uint8_t y, const uint8_t length) {
    for (uint8_t i = 0; i < length; i++) {
        setPixel(x + i, y, true);
    }
}

void OledDisplay::drawVerticalLine(const uint8_t x, const uint8_t y, const uint8_t length) {
    for (uint8_t i = 0; i < length; i++) {
        setPixel(x, y + i, true);
    }
}

void OledDisplay::drawRectangle(const uint8_t x, const uint8_t y, const uint8_t width, const uint8_t height) {
    drawHorizontalLine(x, y, width);
    drawHorizontalLine(x, y + height - 1, width);
    drawVerticalLine(x, y, height);
    drawVerticalLine(x + width - 1, y, height);
}

void OledDisplay::fillRectangle(const uint8_t x, const uint8_t y, const uint8_t width, const uint8_t height) {
    for (uint8_t row = 0; row < height; row++) {
        drawHorizontalLine(x, y + row, width);
    }
}

bool OledDisplay::isBacklightOn() const {
    return driver.isDisplayOn();
}
